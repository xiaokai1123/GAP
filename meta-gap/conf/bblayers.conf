## meta-gap/conf/bblayers.conf
```bitbake
#
BBLAYERS += "##OPENEMBEDDEDDIR##/meta-oe"
BBLAYERS += "##OPENEMBEDDEDDIR##/meta-python"
BBLAYERS += "##OPENEMBEDDEDDIR##/meta-networking"
BBLAYERS += "##OPENEMBEDDEDDIR##/meta-webserver"
BBLAYERS += "##OPENEMBEDDEDDIR##/../meta-selinux"
```

## meta-gap/conf/layer.conf
```bitbake
# We have a conf and classes directory, add to BBPATH
BBPATH .= ":${LAYERDIR}"

# We have recipes-* directories, add to BBFILES
BBFILES += "${LAYERDIR}/recipes-*/*/*.bb \
	${LAYERDIR}/recipes-*/*/*.bbappend"

BBFILE_COLLECTIONS += "gap"
BBFILE_PATTERN_gap = "^${LAYERDIR}/"
BBFILE_PRIORITY_gap = "5"

LAYERVERSION_gap = "1"

LAYERSERIES_COMPAT_gap = "sumo"

PREFERRED_VERSION_iptables = "1.4.%"
#PREFERRED_VERSION_iproute2 = "3.%"
```

## meta-gap/conf/machine/gapx86.conf
```bitbake
#@TYPE: Machine
#@NAME: x86_64
#@DESCRIPTION: Machine configuration for running an X86 system

DEFAULTTUNE ?= "core2-64"

require conf/machine/include/tune-core2.inc

KERNEL_IMAGETYPE = "bzImage"

SERIAL_CONSOLE = "115200;ttyS0"

BASELIB_gapx86 = "lib64"
```
